## wifimanager/Kconfig.projbuild
```kconfig
menu "WifiManager Configuration"   
    config NETWORK_WIFI_AP_SSID
        string "WiFi AP SSID"
        default "labathome-%02X%02X%02X"
        help
            SSID (network name) to use as AP
    config NETWORK_WIFI_AP_PASSWORD
        string "WiFi AP Password"
        default "labathome"
    config NETWORK_WIFI_AP_CHANNEL
        int "Wifi AP Channel"
        default 11
    config NETWORK_AP_MAX_AP_CONN
        int "Maximal connections to access point"
        default 2
    config NETWORK_HOSTNAME_PATTERN
        string "Hostname pattern"
        default "labathome-%02X%02X%02X"
endmenu
```
